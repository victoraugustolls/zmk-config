## boards/shields/klor/Kconfig.shield
```kconfig
config SHIELD_KLOR_LEFT
    def_bool $(shields_list_contains,klor_left)

config SHIELD_KLOR_RIGHT
    def_bool $(shields_list_contains,klor_right)

config SHIELD_MY_KEYBOARD_DONGLE
    def_bool $(shields_list_contains,my_keyboard_dongle)
```
